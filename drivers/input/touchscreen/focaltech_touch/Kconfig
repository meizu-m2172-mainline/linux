## drivers/input/touchscreen/focaltech_touch/Kconfig
```kconfig
# SPDX-License-Identifier: GPL-2.0-only
config TOUCHSCREEN_FTS
	tristate "FocalTech FT3518 I2C touchscreen"
	depends on I2C
	help
	  Say Y here if you have a FocalTech FT3518 (or compatible) I2C
	  touchscreen.

	  If unsure, say N.

	  To compile this driver as a module, choose M here: the
	  module will be called focaltech_ts.
```

## drivers/media/radio/rtc6226/Kconfig
```kconfig
# SPDX-License-Identifier: GPL-2.0-only
config RADIO_RTC6226
	tristate "Richtek RTC6226 FM radio receiver support"
	depends on I2C && VIDEO_DEV
	help
	  This is a driver for I2C devices with the Richtek RTC6226
	  FM radio receiver chip.

	  Say Y here if you want to connect this type of radio to your
	  system via I2C bus.

	  To compile this driver as a module, choose M here:
	  the module will be called radio-rtc6226-i2c.
```

## sound/soc/codecs/aw882xx/Kconfig
```kconfig
#
# awinic aw882xx
#

config SND_SOC_AW882xx
	tristate "Soc Audio for awinic aw882xx"
	depends on I2C
	select CRC32
	select REGMAP_I2C
	select GPIOLIB
	select SND_SOC_AW88395_LIB
	help
	  this option enables support for aw88395 Smart PA.
	  The Awinic AW88395 is an I2S/TDM input, high efficiency
	  digital Smart K audio amplifier with an integrated 10V
	  smart boost convert.
```
