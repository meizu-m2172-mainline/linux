// SPDX-License-Identifier: GPL-2.0-only OR BSD-2-Clause
/dts-v1/;

#include "sm8250-meizu-m2172-common.dtsi"

&panel {
	compatible = "visionox,rm692e5";
	vddio-supply = <&vreg_l14a_1p88>;
	vdd-supply = <&vreg_l16a_3p3>;
};
