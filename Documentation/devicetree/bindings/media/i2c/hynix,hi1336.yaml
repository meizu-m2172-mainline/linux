## Documentation/devicetree/bindings/media/i2c/hynix,hi1336.yaml
```yaml
# SPDX-License-Identifier: (GPL-2.0-only OR BSD-2-Clause)
%YAML 1.2
---
$id: http://devicetree.org/schemas/media/i2c/hynix,hi1336.yaml#
$schema: http://devicetree.org/meta-schemas/core.yaml#

title: SK Hynix Hi-1336 Image Sensor

description:
  The Hi-1336 is a 13MP raw image sensor controlled over I2C and
  transmitting RAW10 data over a 4-lane MIPI CSI-2 D-PHY interface.

maintainers:
  - Athbe <athbe@users.noreply.github.com>

allOf:
  - $ref: /schemas/media/video-interface-devices.yaml#

properties:
  compatible:
    const: hynix,hi1336

  reg:
    maxItems: 1

  clocks:
    description: MCLK supply clock.
    maxItems: 1

  reset-gpios:
    description: Active low GPIO connected to the sensor reset pin.
    maxItems: 1

  vdda-supply:
    description: Analogue voltage supply.

  vddd-supply:
    description: Digital core voltage supply.

  vddio-supply:
    description: Digital I/O voltage supply.

  port:
    $ref: /schemas/graph.yaml#/$defs/port-base
    additionalProperties: false

    properties:
      endpoint:
        $ref: /schemas/media/video-interfaces.yaml#
        unevaluatedProperties: false

        properties:
          data-lanes:
            items:
              - const: 1
              - const: 2
              - const: 3
              - const: 4

        required:
          - link-frequencies

required:
  - compatible
  - reg
  - clocks
  - port

unevaluatedProperties: false

examples:
  - |
      #include <dt-bindings/gpio/gpio.h>

      i2c {
          #address-cells = <1>;
          #size-cells = <0>;

          camera@20 {
              compatible = "hynix,hi1336";
              reg = <0x20>;
              clocks = <&camera_mclk>;
              reset-gpios = <&tlmm 78 GPIO_ACTIVE_LOW>;
              vdda-supply = <&vreg_2p8>;
              vddd-supply = <&vreg_1p1>;
              vddio-supply = <&vreg_1p8>;

              port {
                  endpoint {
                      data-lanes = <1 2 3 4>;
                      link-frequencies = /bits/ 64 <360000000 720000000>;
                      remote-endpoint = <&mipi_csi2_ep>;
                  };
              };
          };
      };
...
```

## Documentation/devicetree/bindings/media/i2c/samsung,s5kgw3.yaml
```yaml
# SPDX-License-Identifier: (GPL-2.0-only OR BSD-2-Clause)
%YAML 1.2
---
$id: http://devicetree.org/schemas/media/i2c/samsung,s5kgw3.yaml#
$schema: http://devicetree.org/meta-schemas/core.yaml#

title: Samsung S5KGW3 Image Sensor

description:
  Samsung S5KGW3 is a 64MP raw image sensor controlled over I2C and
  transmitting RAW10 data over a 4-lane MIPI CSI-2 D-PHY interface.

maintainers:
  - Athbe <athbe@users.noreply.github.com>

allOf:
  - $ref: /schemas/media/video-interface-devices.yaml#

properties:
  compatible:
    const: samsung,s5kgw3

  reg:
    maxItems: 1

  clocks:
    description: MCLK supply clock.
    maxItems: 1

  reset-gpios:
    description: Active low GPIO connected to the sensor reset pin.
    maxItems: 1

  vdda-supply:
    description: Analogue voltage supply.

  vddd-supply:
    description: Digital core voltage supply.

  vddio-supply:
    description: Digital I/O voltage supply.

  port:
    $ref: /schemas/graph.yaml#/$defs/port-base
    additionalProperties: false

    properties:
      endpoint:
        $ref: /schemas/media/video-interfaces.yaml#
        unevaluatedProperties: false

        properties:
          data-lanes:
            items:
              - const: 1
              - const: 2
              - const: 3
              - const: 4

        required:
          - link-frequencies

required:
  - compatible
  - reg
  - clocks
  - port

unevaluatedProperties: false

examples:
  - |
      #include <dt-bindings/gpio/gpio.h>

      i2c {
          #address-cells = <1>;
          #size-cells = <0>;

          camera@2d {
              compatible = "samsung,s5kgw3";
              reg = <0x2d>;
              clocks = <&camera_mclk>;
              reset-gpios = <&tlmm 93 GPIO_ACTIVE_LOW>;
              vdda-supply = <&vreg_2p8>;
              vddd-supply = <&vreg_1p05>;
              vddio-supply = <&vreg_1p8>;

              port {
                  endpoint {
                      data-lanes = <1 2 3 4>;
                      link-frequencies = /bits/ 64 <600000000 660000000
                                                       888000000 1000000000
                                                       1050000000>;
                      remote-endpoint = <&mipi_csi2_ep>;
                  };
              };
          };
      };
...
```

## drivers/bus/mhi/host/Kconfig
```kconfig
# SPDX-License-Identifier: GPL-2.0
#
# MHI bus
#
# Copyright (c) 2018-2020, The Linux Foundation. All rights reserved.
#

config MHI_BUS
	tristate "Modem Host Interface (MHI) bus"
	help
	  Bus driver for MHI protocol. Modem Host Interface (MHI) is a
	  communication protocol used by the host processors to control
	  and communicate with modem devices over a high speed peripheral
	  bus or shared memory.

config MHI_BUS_DEBUG
	bool "Debugfs support for the MHI bus"
	depends on MHI_BUS && DEBUG_FS
	help
	  Enable debugfs support for use with the MHI transport. Allows
	  reading and/or modifying some values within the MHI controller
	  for debug and test purposes.

config MHI_BUS_PCI_GENERIC
	tristate "MHI PCI controller driver"
	depends on MHI_BUS
	depends on PCI
	help
	  This driver provides MHI PCI controller driver for devices such as
	  Qualcomm SDX55 based PCIe modems.

config MHI_SAHARA
	tristate "MHI SAHARA/EFS pipe driver for Qualcomm SDX55M"
	depends on MHI_BUS
	help
	  Expose the SAHARA SBL image-transfer channel as /dev/mhi_pipe_2 and
	  the post-AMSS EFS sync channel as /dev/mhi_pipe_10 for SDX55M bring-up.
	  This mirrors the Android downstream mhi_uci userspace contract more
	  closely than binding those private pipes through the WWAN core.

	  To compile this driver as a module, choose M here: the module will be
	  called mhi_sahara.
```
